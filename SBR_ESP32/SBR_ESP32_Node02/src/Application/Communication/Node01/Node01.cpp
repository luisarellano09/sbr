/**
 * @file Node01.cpp
 * @author Luis Arellano (luis.arellano09@gmail.com)
 * @brief class to Manage the Node01
 * @version 2.0
 * @date 09.01.2021
 * 
 * 
 */


/*******************************************************************************************************************************************
 *  												INCLUDE
 *******************************************************************************************************************************************/
#include "Node01.h"

/*******************************************************************************************************************************************
 *  												CONSTRUCTOR
 *******************************************************************************************************************************************/

Node01::Node01(HardwareSerial* serial, uint32_t baud, uint8_t RX, uint8_t TX) : Node(serial, baud, RX, TX){    


}

//=====================================================================================================
Node01::~Node01(){}

/*******************************************************************************************************************************************
 *  												PUBLIC METHODS
 *******************************************************************************************************************************************/

void Node01::clear(){
    for (int i=0; i<10000; i++){
        test[i] = -1;
    }
    index = 0;
}

void Node01::printtest(){
    for (int i=0; i<10000; i++){
        if (test[i] != -1){
            Serial.printf("Data[%d]: %d\r\n", i, test[i]);
        }
    }

}

/*******************************************************************************************************************************************
 *  												PRIVATE METHODS
 *******************************************************************************************************************************************/

RC_e Node01::HandleRequest(Request* request){

    if (index>=10000){
        index = 9999;
    }
    test[index] = request->data;
    index++;


    return RC_e::SUCCESS;
    bool startTest = false;

}

